## Documentation/devicetree/bindings/display/panel/ilitek,ili9805.yaml
```yaml
# SPDX-License-Identifier: (GPL-2.0-only OR BSD-2-Clause)
%YAML 1.2
---
$id: http://devicetree.org/schemas/display/panel/ilitek,ili9805.yaml#
$schema: http://devicetree.org/meta-schemas/core.yaml#

title: Ilitek ILI9805 based MIPI-DSI panels

maintainers:
  - Michael Trimarchi <michael@amarulasolutions.com>

properties:
  compatible:
    items:
      - enum:
          - giantplus,gpm1790a0
          - tianma,tm041xdhg01
      - const: ilitek,ili9805

  avdd-supply: true
  dvdd-supply: true
  power-supply: true
  port: true
  reg: true
  reset-gpios: true
  backlight: true

required:
  - compatible
  - avdd-supply
  - dvdd-supply
  - reg
  - reset-gpios

additionalProperties: false

examples:
  - |
    #include <dt-bindings/gpio/gpio.h>

    dsi {
        #address-cells = <1>;
        #size-cells = <0>;

        panel@0 {
            compatible = "giantplus,gpm1790a0", "ilitek,ili9805";
            reg = <0>;
            power-supply = <&reg_display>;
            avdd-supply = <&avdd_display>;
            dvdd-supply = <&dvdd_display>;
            reset-gpios = <&r_pio 0 5 GPIO_ACTIVE_LOW>; /* PL05 */

            port {
                panel_in: endpoint {
                    remote-endpoint = <&mipi_dsi_out>;
                };
            };
        };
    };

...
```
